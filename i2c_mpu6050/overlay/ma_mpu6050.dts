/dts-v1/;
/plugin/;

/ {
    compatible = "brcm,bcm2835";

    fragment@0 {
        target = <&i2c1>;
        __overlay__ {
            status = "okay";
         ma_mpu6050@68 {
             compatible = "ma,mpu6050";
             reg = <0x68>;

             status = "okay";
};
         };

    };
};
